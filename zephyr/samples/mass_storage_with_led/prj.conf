## CMakeLists.txt
```
# SPDX-License-Identifier: Apache-2.0

cmake_minimum_required(VERSION 3.20.0)

set(ZEPHYR_SDK_INSTALL_DIR "/opt/zephyr-sdk-0.16.1")

set(BOARD "stm32f401_mini")

find_package(Zephyr REQUIRED HINTS $ENV{ZEPHYR_BASE} PACKAGE_FIND_VERSION 0.16.1)
project(mass_storage_with_led)

FILE(GLOB app_sources src/*.c)
target_sources(app PRIVATE
  src/main.c
  src/tled_disk.c)
```

## prj.conf
```kconfig
CONFIG_DEBUG=y
CONFIG_STDOUT_CONSOLE=n

#USB related configs
CONFIG_USB_DEVICE_STACK=y
CONFIG_USB_DEVICE_PRODUCT="Zephyr MASS sample"
CONFIG_USB_DEVICE_PID=0x0008
CONFIG_LOG=n
CONFIG_USB_DRIVER_LOG_LEVEL_ERR=y
CONFIG_USB_MASS_STORAGE=y
CONFIG_USB_DEVICE_LOG_LEVEL_ERR=y
CONFIG_USB_MASS_STORAGE_LOG_LEVEL_ERR=n
CONFIG_MASS_STORAGE_DISK_NAME="TESTLED"
CONFIG_DEBUG_OPTIMIZATIONS=y
CONFIG_FILE_SYSTEM=y


CONFIG_MAIN_STACK_SIZE=1536
CONFIG_I2C=y
```

## src/main.c
```c
#include <zephyr/kernel.h>
#include <zephyr/logging/log.h>
#include <zephyr/usb/usb_device.h>
#include <zephyr/fs/fs.h>
#include <stdio.h>

LOG_MODULE_REGISTER(main);

#include <zephyr/storage/flash_map.h>

static struct fs_mount_t fs_mnt;

static int mount_app_fs(struct fs_mount_t *mnt)
{
	int rc;
	rc = fs_mount(mnt);
	return rc;
}


static void setup_disk(void)
{
	struct fs_mount_t *mp = &fs_mnt;
	struct fs_dir_t dir;
	struct fs_statvfs sbuf;
	int rc;

	fs_dir_t_init(&dir);

	rc = mount_app_fs(mp);
	if (rc < 0) {
		LOG_ERR("Failed to mount filesystem");
		return;
	}

	/* Allow log messages to flush to avoid interleaved output */
	k_sleep(K_MSEC(50));

	printk("Mount %s: %d\n", fs_mnt.mnt_point, rc);

	rc = fs_statvfs(mp->mnt_point, &sbuf);
	if (rc < 0) {
		printk("FAIL: statvfs: %d\n", rc);
		return;
	}

	printk("%s: bsize = %lu ; frsize = %lu ;"
	       " blocks = %lu ; bfree = %lu\n",
	       mp->mnt_point,
	       sbuf.f_bsize, sbuf.f_frsize,
	       sbuf.f_blocks, sbuf.f_bfree);

	rc = fs_opendir(&dir, mp->mnt_point);
	printk("%s opendir: %d\n", mp->mnt_point, rc);

	if (rc < 0) {
		LOG_ERR("Failed to open directory");
	}

	while (rc >= 0) {
		struct fs_dirent ent = { 0 };

		rc = fs_readdir(&dir, &ent);
		if (rc < 0) {
			LOG_ERR("Failed to read directory entries");
			break;
		}
		if (ent.name[0] == 0) {
			printk("End of files\n");
			break;
		}
		printk("  %c %u %s\n",
		       (ent.type == FS_DIR_ENTRY_FILE) ? 'F' : 'D',
		       ent.size,
		       ent.name);
	}

	(void)fs_closedir(&dir);

	return;
}

void main(void)
{
	int ret;

	setup_disk();

	ret = usb_enable(NULL);
	if (ret != 0) {
		LOG_ERR("Failed to enable USB");
		return;
	}

	LOG_INF("The device is put in USB mass storage mode.\n");
}
```

## src/tled_disk.c
```c
/*
 * This code based on:
 * https://github.com/zephyrproject-rtos/zephyr/blob/main/drivers/disk/ramdisk.c
 */

#include <string.h>
#include <zephyr/types.h>
#include <zephyr/drivers/disk.h>
#include <errno.h>
#include <zephyr/init.h>
#include <zephyr/device.h>
#include <zephyr/logging/log.h>
#include <zephyr/kernel.h>
#include <zephyr/drivers/gpio.h>

#define DISK_TLED_NAME "TESTLED"

#define TLED_SECTOR_SIZE 512
#define TLED_VOLUME_SIZE (TLED_SECTOR_SIZE * 1)
#define TLED_SECTOR_COUNT (TLED_VOLUME_SIZE / TLED_SECTOR_SIZE)

static uint8_t ramdisk_buf[TLED_VOLUME_SIZE];

#define LED0_NODE DT_ALIAS(led0)

static void *lba_to_address(uint32_t lba)
{
	return &ramdisk_buf[lba * TLED_SECTOR_SIZE];
}

static int disk_TLED_access_status(struct disk_info *disk)
{
	return DISK_STATUS_OK;
}

static int disk_TLED_access_init(struct disk_info *disk)
{
	return 0;
}

static int disk_TLED_access_read(struct disk_info *disk, uint8_t *buff,
				uint32_t sector, uint32_t count)
{
	uint32_t last_sector = sector + count;

	if (last_sector < sector || last_sector > TLED_SECTOR_COUNT) {
		return -EIO;
	}

	memcpy(buff, lba_to_address(sector), count * TLED_SECTOR_SIZE);

	return 0;
}

static const struct gpio_dt_spec led = GPIO_DT_SPEC_GET(LED0_NODE, gpios);

static int disk_TLED_access_write(struct disk_info *disk, const uint8_t *buff,
				 uint32_t sector, uint32_t count)
{
	uint32_t last_sector = sector + count;

	if (last_sector < sector || last_sector > TLED_SECTOR_COUNT) {
		return -EIO;
	}

	void * write_address = lba_to_address(sector);
	if(buff != NULL && write_address == ramdisk_buf && count != 0)
	{
		gpio_pin_set_dt(&led, *buff&0x1);
	}

	memcpy(lba_to_address(sector), buff, count * TLED_SECTOR_SIZE);

	return 0;
}

static int disk_TLED_access_ioctl(struct disk_info *disk, uint8_t cmd, void *buff)
{
	switch (cmd) {
	case DISK_IOCTL_CTRL_SYNC:
		break;
	case DISK_IOCTL_GET_SECTOR_COUNT:
		*(uint32_t *)buff = TLED_SECTOR_COUNT;
		break;
	case DISK_IOCTL_GET_SECTOR_SIZE:
		*(uint32_t *)buff = TLED_SECTOR_SIZE;
		break;
	case DISK_IOCTL_GET_ERASE_BLOCK_SZ:
		*(uint32_t *)buff  = 1U;
		break;
	default:
		return -EINVAL;
	}

	return 0;
}

static const struct disk_operations ram_disk_ops = {
	.init = disk_TLED_access_init,
	.status = disk_TLED_access_status,
	.read = disk_TLED_access_read,
	.write = disk_TLED_access_write,
	.ioctl = disk_TLED_access_ioctl,
};

static struct disk_info TLED_disk = {
	.name = DISK_TLED_NAME,
	.ops = &ram_disk_ops,
};

static int disk_ram_init(const struct device *dev)
{
	ARG_UNUSED(dev);

	int ret = 0;

	if (!gpio_is_ready_dt(&led)) {
		return -EINVAL;
	}

	ret = gpio_pin_configure_dt(&led, GPIO_OUTPUT_ACTIVE);
	if (ret < 0) {
		return ret;
	}

	gpio_pin_set_dt(&led, 0);

	return disk_access_register(&TLED_disk);
}

SYS_INIT(disk_ram_init, APPLICATION, CONFIG_KERNEL_INIT_PRIORITY_DEFAULT);
```
